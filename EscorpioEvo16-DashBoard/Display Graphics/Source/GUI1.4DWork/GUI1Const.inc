// File generated 05/10/2015 18:13:59
// Warning! This is a generated file, any manual changes will be
// lost during the next generation.

#constant  Strings0Count    0
#constant  Strings0Size     1
#constant  Strings1Count    0
#constant  Strings1Size     1
#constant  Strings2Count    0
#constant  Strings2Size     1
#constant  Strings3Count    0
#constant  Strings3Size     1
#constant  Strings4Count    0
#constant  Strings4Size     1
#constant  Strings5Count    0
#constant  Strings5Size     1
// object indexes into ImageControl
#CONST
    iStatictext0    // offset 0x0
    iLeddigits0     // offset 0x1600
    iiLeddigits0    // offset 0x3C00
    iStatictext1    // offset 0x8A00
    iLeddigits1     // offset 0x9400
    iiLeddigits1    // offset 0xB600
    iAngularmeter0  // offset 0x10A00
    iAngularmeter1  // offset 0x9B200
    iLeddigits2     // offset 0x125A00
    iiLeddigits2    // offset 0x127C00
    iLeddigits3     // offset 0x12D000
    iiLeddigits3    // offset 0x12F200
    iGauge0         // offset 0x134600
    iStatictext2    // offset 0x301000
    iLeddigits4     // offset 0x302400
    iiLeddigits4    // offset 0x304400
    iLeddigits5     // offset 0x309400
    iiLeddigits5    // offset 0x30B600
    iStatictext3    // offset 0x310A00
    iStatictext4    // offset 0x311A00
    iUserled0       // offset 0x313000
    iStatictext5    // offset 0x316400
    iStatictext6    // offset 0x316800
    iUserled1       // offset 0x316C00
    iLeddigits6     // offset 0x31A000
    iiLeddigits6    // offset 0x31AC00
    iStatictext7    // offset 0x31E400
    iStatictext8    // offset 0x31E800
    iStatictext9    // offset 0x31F000
    iStatictext10   // offset 0x31F800
    iStatictext11   // offset 0x320200
    iStatictext12   // offset 0x321200
    iStatictext13   // offset 0x321A00
    iLeddigits7     // offset 0x322200
    iiLeddigits7    // offset 0x324400
    iLeddigits8     // offset 0x329800
    iiLeddigits8    // offset 0x32A200
    iUserled2       // offset 0x32F600
    iStatictext14   // offset 0x332A00
    iSpectrum0      // offset 0x333200
    iiSpectrum0     // offset 0x34A200
    iWinbutton0     // offset 0x414600
    iWinbutton1     // offset 0x418800
    iWinbutton2     // offset 0x41CA00
    iWinbutton3     // offset 0x420C00
    iWinbutton4     // offset 0x423200
    iWinbutton5     // offset 0x425800
#END

#constant  Strings0StartH   0x0
#constant  Strings0StartL   0x0
#constant  Strings1StartH   0x0
#constant  Strings1StartL   0x200
#constant  Strings2StartH   0x0
#constant  Strings2StartL   0x400
#constant  Strings3StartH   0x0
#constant  Strings3StartL   0x600
#constant  Strings4StartH   0x0
#constant  Strings4StartL   0x800
#constant  Strings5StartH   0x0
#constant  Strings5StartL   0xA00
#IFNOT EXISTS NOGLOBALS
var hndl ;
#ENDIF
