// File generated 29/06/2016 16:43:12
// Warning! This is a generated file, any manual changes will be
// lost during the next generation.

#constant  Strings0Count    0
#constant  Strings0Size     1
#constant  Strings1Count    1
#constant  Strings1Size     5
#constant  Strings2Count    1
#constant  Strings2Size     9
#constant  Strings8Count    0
#constant  Strings8Size     1
#constant  Strings3Count    1
#constant  Strings3Size     9
#constant  Strings4Count    0
#constant  Strings4Size     1
#constant  Strings5Count    0
#constant  Strings5Size     1
#constant  Strings6Count    0
#constant  Strings6Size     1
#constant  Strings7Count    1
#constant  Strings7Size     21
// object indexes into ImageControl
#CONST
    iForm0          // offset 0x0
    iLeddigits0     // offset 0x3FE00
    iiLeddigits0    // offset 0x46400
    iLeddigits1     // offset 0x56200
    iiLeddigits1    // offset 0x5C800
    iGauge0         // offset 0x6C600
    iStatictext0    // offset 0x31AE00
    iStatictext1    // offset 0x31BE00
    iStatictext2    // offset 0x31CE00
    iStatictext3    // offset 0x31D800
    iStatictext4    // offset 0x31E600
    iLeddigits2     // offset 0x31F000
    iiLeddigits2    // offset 0x322E00
    iLeddigits3     // offset 0x32C600
    iiLeddigits3    // offset 0x32D600
    iStatictext5    // offset 0x332600
    iStatictext6    // offset 0x332A00
    iStatictext7    // offset 0x333800
    iUserled0       // offset 0x333E00
    iUserled1       // offset 0x336400
    iStatictext8    // offset 0x337600
    iStatictext9    // offset 0x337A00
    iLeddigits4     // offset 0x338000
    iiLeddigits4    // offset 0x33BE00
    iLeddigits5     // offset 0x345600
    iiLeddigits5    // offset 0x349400
    iUserimages0    // offset 0x352C00
    iLeddigits8     // offset 0x382E00
    iiLeddigits8    // offset 0x385200
    iStatictext14   // offset 0x38AA00
    iLeddigits9     // offset 0x38B800
    iiLeddigits9    // offset 0x38C200
    iSpectrum0      // offset 0x391600
    iiSpectrum0     // offset 0x3A4200
    iLeddigits6     // offset 0x430400
    iiLeddigits6    // offset 0x432200
    iStatictext10   // offset 0x436E00
    iStatictext11   // offset 0x437E00
    iLeddigits7     // offset 0x438A00
    iiLeddigits7    // offset 0x439400
    iStatictext12   // offset 0x43E800
    iStatictext13   // offset 0x43F600
    iWinbutton0     // offset 0x440400
    iWinbutton1     // offset 0x444800
    iWinbutton2     // offset 0x448C00
    iWinbutton12    // offset 0x44D000
    iWinbutton14    // offset 0x451400
    iWinbutton3     // offset 0x455800
    iWinbutton4     // offset 0x458000
    iWinbutton5     // offset 0x45A800
    iWinbutton6     // offset 0x45D600
    iWinbutton7     // offset 0x460400
    iWinbutton8     // offset 0x461A00
    iWinbutton9     // offset 0x463000
    iWinbutton10    // offset 0x464600
    iWinbutton11    // offset 0x465C00
    iWinbutton13    // offset 0x467200
#END

#constant  Strings0StartH   0x0
#constant  Strings0StartL   0x0
#constant  Strings1StartH   0x0
#constant  Strings1StartL   0x200
#constant  Strings2StartH   0x0
#constant  Strings2StartL   0x400
#constant  Strings8StartH   0x0
#constant  Strings8StartL   0x600
#constant  Strings3StartH   0x0
#constant  Strings3StartL   0x800
#constant  Strings4StartH   0x0
#constant  Strings4StartL   0xA00
#constant  Strings5StartH   0x0
#constant  Strings5StartL   0xC00
#constant  Strings6StartH   0x0
#constant  Strings6StartL   0xE00
#constant  Strings7StartH   0x0
#constant  Strings7StartL   0x1000
#IFNOT EXISTS NOGLOBALS
var hndl ;
#ENDIF
